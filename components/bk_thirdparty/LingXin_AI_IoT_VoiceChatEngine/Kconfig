## components/bk_thirdparty/asr/wanson_foreign/Kconfig
```kconfig
menu "Bk_thirdparty::Wanson_Foreign"

	config WANSON_FOREIGN_ASR
		bool "Enable Wanson_Foreign ASR"
		default n
		help
			Enable Wanson_Foreign Automatic Speech Recognition

	config WANSON_FL_LICENSE
		bool "Enable Wanson FL License"
		default n
		help
			Enable Wanson Foreign language License for authentication and usage rights
	
endmenu
```

## components/bk_thirdparty/unisound/Kconfig
```kconfig
menu "Bk_thirdparty::Unisound"

	config UNISOUND
		bool "Enable Unisound ASR"
		default n
		help
			Enable Unisound Automatic Speech Recognition
	config UNISOUND_LICENSE
		bool "Enable Unisound License"
		default n
		help
			Enable Unisound License for authentication and usage rights
endmenu
```
