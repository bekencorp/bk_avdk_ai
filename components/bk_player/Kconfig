## components/bk_player/Kconfig
```kconfig
menu "Bk_player"
	config PLAYER
		bool "Enable PLAYER"
		default n

	choice PLAYER_USE_MEMORY
		depends on PLAYER
		prompt "Select Player use memory"
		default PLAYER_USE_PSRAM

		config PLAYER_USE_SRAM
			bool "Enable player use sram"
			help
				player use sram memory

		config PLAYER_USE_PSRAM
			depends on PSRAM
			bool "Enable player use psram"
			help
				player use psram memory
	endchoice

	config PLAYER_ENABLE_SOURCE_NET
		depends on PLAYER
		bool "Enable Source Net"
		default n

	config PLAYER_ENABLE_CODEC_MP3
		depends on PLAYER
		bool "Enable Codec MP3"
		default n

	config PLAYER_ENABLE_SINK_ONBOARD_SPEAKER
		depends on PLAYER && AUDIO_DAC
		bool "Enable Sink Device"
		default y

	config PLAYER_ENABLE_SINK_VOICE_SPEAKER
		depends on PLAYER && AUD_INTF_SUPPORT_MUSIC_SPK_SOURCE
		bool "Enable write speaker data to aud_intf component, and aud_intf play speaker data in voice mode"
		default y

	config PLAYER_TEST
		depends on PLAYER
		bool "Enable Player Test"
		default n

    config PA_MUTE_EN
        bool "Enable PA mute"
        default n

    config MUTE_PIN
        depends on PA_MUTE_EN
        int "pa mute gpio"
        range 0 47
        default 8

    config MUTE_LEVEL
        depends on PA_MUTE_EN
        int "pa mute valid level"
        range 0 1
        default 0

    config PLAYER_READ_DATA_TIMEOUT_MS
        depends on PLAYER
        int "Config layer read data timeout(ms)"
        range 100 60000
        default 3000
	    help
            Player will automatically stop and report event when player read data timeout. The timeout duration must be a multiple of 100ms.

endmenu
```

## components/bk_thirdparty/agora-iot-sdk/Kconfig
```kconfig
menu "Bk_thirdparty::agora-iot-sdk"

	config AGORA_IOT_SDK
		bool "Enable Agora iot sdk"
		default n
		help
			Enable Agora iot sdk lib

	choice AGORA_IOT_SDK_VERSION
		depends on AGORA_IOT_SDK
		prompt "Select Agora_IOT_SDK Version"
		default AGORA_IOT_SDK_VERSION_DEFAULT

		config AGORA_IOT_SDK_VERSION_DEFAULT
		bool "Select Agora_IOT_SDK Default Version"

		config AGORA_IOT_SDK_VERSION_1
		bool "Select Agora_IOT_SDK Version 1"
		help
			Support audio codec
	endchoice

endmenu
```

## components/bk_thirdparty/aliyun_sdk/Kconfig
```kconfig
#TODO remove all kconfigs which are defined in armino libs

menu "aliyunsdk"

	config ALIYUN_MMI_EN
		bool "Enable BaiLian AI"
		default n
		help
			Enable BaiLian AI
endmenu
```

## components/multimedia/Kconfig
```kconfig
menu "Media"

	config MEDIA
		bool "Enable Media"
		default n
		help
			Enable media service

	config MEDIA_MAJOR
		bool "Enable Media"
		default n

	config MEDIA_APP
		bool "Enable Media"
		default n

	config MEDIA_MINOR
		bool "Enable Media"
		default n

	config MEDIA_UI_TASK_STACK_SIZE
		int "Set media ui task stack size"
		default 2048

	config WIFI_TRANSFER
		depends on MEDIA
		bool "Enable Wifi Transfer"
		default n

	config USB_TRANSFER
		depends on MEDIA
		bool "Enable usb Transfer"
		default n

	config LCD_FLASH_JPEG_DISPLAY
		depends on LCD
		bool "Enable Lcd Flash Jpeg Display"
		default n
		help
			enable lcd display flash img

	config LCD_DMA2D_BLEND
		depends on DMA2D
		bool "Enable Lcd Dma2d Blend Flash Img"
		default n
		help
			enable lcd dma2d blend flash logo

	config BLEND_USE_GUI
		depends on LCD
		bool "Enable Blend Use Gui"
		default n
		help
			enable lcd dma2d blend from gui

	config BLEND_GUI_OUTPUT_888
		depends on LCD
		bool "Enable Blend Gui Output 888"
		default n
		help
			enable lcd dma2d blend from gui, gui data is rgb888

	config LCD_FONT_BLEND
		depends on LCD
		bool "Enable Lcd Font Blend"
		default n
		help
			enable lcd blend by font logo

	config IMAGE_STORAGE
		depends on MEDIA
		bool "enable image storage function"
		default n
		help
			enable image save and read image

	config JPEG_YUV_MIX
		depends on DVP_CAMERA
		bool "enable jpeg module for jpeg and yuv mix mode"
		default n
		help
			enable jpeg work method: encode and yuv by turns

	config EXTENTED_PSRAM_LAYOUT
		bool "Externally controlling the PSRAM range of the framebuffer"
		default n
		help
			extern external fb_layout variable

	config TRANS_APP_TASK_SIZE
		int "Set transfer app task size"
		default 1024

	config LCD_ROTATE
		depends on LCD
		bool "Enable Lcd rotate function"
		default n

	config LCD_HW_PFC
		depends on LCD
		bool "Enable Lcd hw pixel convert"
		default n

	config LCD_HW_DECODE
		depends on LCD
		bool "Enable Lcd hw decode"
		default n

	config SW_ROTATE_TO_YUYV_AND_DMA2D_TO_YUYV_NOT_RGB888
		depends on LCD
		bool "Enable Lcd hw decode"
		default n

	config LCD_SW_DECODE
		depends on LCD
		bool "Enable Lcd sw decode"
		default n

	config LCD_AUTO_FILL_FULL
		depends on LCD
		bool "Enable Lcd sw decode"
		default n

	config MEDIA_SCALE
		depends on LCD
		bool "Enable Lcd scale"
		default n

	config MEDIA_PIPELINE
		depends on LCD
		bool "Enable Lcd scale"
		default n

	config AUD_INTF_TEST
		bool "Enable Aud intf test"
		default n

	config AUD_INTF_SUPPORT_G722
		bool "Enable Aud intf support G722 data type"
		default n

	config AUD_INTF_SUPPORT_AI_DIALOG_FREE
		bool "Enable Aud intf support ai_dialog_free"
		default n

	choice AUD_TRAS_USE_MEMORY
		prompt "Select AUD TRAS use memory"
		default AUD_TRAS_USE_PSRAM

		config AUD_TRAS_USE_SRAM
		bool "Enable AUD TRAS use sram"
		help
			AUD TRAS use sram memory

		config AUD_TRAS_USE_PSRAM
		bool "Enable AUD TRAS use psram"
		help
			AUD TRAS use psram memory
	endchoice

	config AUD_TRAS_DAC_PA_CTRL
		depends on AUDIO_DAC
		bool "Enable Aud Tras Dac Pa Ctrl"
		default n
		help
			Audio Transfer DAC PA Control Enable

	config AUD_TRAS_DAC_PA_OPEN_DELAY
		depends on AUD_TRAS_DAC_PA_CTRL
		int "Set the delay time(ms) after enabling the audio DAC before enabling the PA."
		range 0 320
		default 2
		help
			Delay opening the PA to ensure DAC stability and avoid pop noise.

	config AUD_TRAS_DAC_PA_CLOSE_DELAY
		depends on AUD_TRAS_DAC_PA_CTRL
		int "Set the delay time(ms) after disabling the PA before disabling the audio DAC."
		range 0 320
		default 2
		help
			Delay closing the audio dac	to ensure PA stability and avoid pop noise.

	config AUD_RING_BUFF_SAFE_INTERVAL
		int "Set Aud Ring Buff Safe Interval"
		range 0 320
		default 4
		help
			Audio ring buff safe interval

    config MEDIA_BT_AUDIO
		bool "BT USE AUDIO Module"
		default n
		help
			BT Module Will Use AUDIO Module

    config SOFTWARE_DECODE_SRAM_MAPPING
        bool "Enable Software Decode Sram Mapping"
		default n

    config MEDIA_PSRAM_SIZE_4M
        bool "The PSRAM used by the media is within 4M."
            default n

	config AUD_DAC_PA_CTRL_GPIO
		depends on AUD_TRAS_DAC_PA_CTRL
		int "Audio DAC PA Controller GPIO Set"
		range 0 100
		default 5

    config AI_AGENT
        bool "Enable AI Agent"
        default n

    config AUD_INTF_SUPPORT_MULTIPLE_SPK_SOURCE_TYPE
        depends on AUD_INTF_SUPPORT_AI_DIALOG_FREE
        bool "Enable support multiple speaker sources, for example prompt tone, a2dp music"
        default n

    config AUD_INTF_SUPPORT_MUSIC_SPK_SOURCE
        depends on AUD_INTF_SUPPORT_MULTIPLE_SPK_SOURCE_TYPE
        bool "Enable support music speaker source include bluetooth a2dp music and url mp3 music"
        default n

    config AUD_INTF_SUPPORT_PROMPT_TONE
		depends on AUD_INTF_SUPPORT_MULTIPLE_SPK_SOURCE_TYPE
        bool "Enable support prompt tone"
        default n

    config AUD_INTF_SUPPORT_PROMPT_TONE_PLAY_FINISH_NOTIFY
		depends on AUD_INTF_SUPPORT_PROMPT_TONE
        bool "Enable prompt tone playback finish notify, notify app when prompt tone playback finish"
        default n

	choice PROMPT_TONE_SOURCE
		depends on AUD_INTF_SUPPORT_PROMPT_TONE
		prompt "Select Prompt Tone Source"
		default PROMPT_TONE_SOURCE_ARRAY

		config PROMPT_TONE_SOURCE_ARRAY
		bool "Select Prompt Tone stored in array"

		config PROMPT_TONE_SOURCE_VFS
		bool "Select Prompt Tone stored in vfs file system"
	endchoice

	config PROMPT_TONE_SOURCE_VFS_MOUNT_ENABLE
		depends on PROMPT_TONE_SOURCE_VFS
		bool "Enable Source VFS of prompt tone automatic mount and unmount"
		default y

	choice PROMPT_TONE_CODEC_TYPE
		depends on AUD_INTF_SUPPORT_PROMPT_TONE
		prompt "Select Prompt Tone Codec Type"
		default PROMPT_TONE_CODEC_PCM

		config PROMPT_TONE_CODEC_PCM
		bool "Select PCM Prompt Tone"

		config PROMPT_TONE_CODEC_MP3
		bool "Select MP3 Prompt Tone"

		config PROMPT_TONE_CODEC_WAV
		bool "Select WAV Prompt Tone"
	endchoice

    config DEBUG_DUMP
        bool "dump debug data"
        default n

    config DEBUG_DUMP_DATA_TYPE_EXTENSION
        depends on DEBUG_DUMP
        bool "extend debug data type"
        default n

    config AI_ASR_MODE_CPU2
        depends on AUD_INTF_SUPPORT_AI_DIALOG_FREE
        bool "Enable AI ASR run in cpu2"
        default n

	choice AEC_VERSION
		prompt "Select AEC Version"
		default AEC_VERSION_V2

		config AEC_VERSION_V1
		bool "Enable AEC V1 Version"

		config AEC_VERSION_V2
		bool "Enable AEC V2 Version"
		
		config AEC_VERSION_V3
		bool "Enable AEC V3 Version"
		
	endchoice

	choice AEC_ECHO_COLLECT_MODE
		prompt "Select AEC Echo Collect Mode"
		default AEC_ECHO_COLLECT_MODE_SOFTWARE

		config AEC_ECHO_COLLECT_MODE_SOFTWARE
		bool "Enable AEC Echo Collect Software Mode"

		config AEC_ECHO_COLLECT_MODE_HARDWARE
		bool "Enable AEC Echo Collect Hardware Mode"
		help
			need connect speaker to mic2
	endchoice

	config AUD_AI_NS_SUPPORT
		bool "Enable AI NS"
		default n

	config AUD_AI_NS_USE_STATIC_SRAM
		bool "AI NS use static sram"
		default n

	config AUD_SWEEP_TEST
		bool "Enable AUD sweep test"
		default n

	config AUD_INTF_SUPPORT_OPUS
		bool "Enable Aud intf support OPUS data type"
		default n
	config AUD_INTF_PROMPT_TONE_SAMPLE_RATE
		int "Prompt tone sample rate"
		default 16000
	config AUD_INTF_SUPPORT_PROMPT_TONE_RESAMPLE
		bool "Support prompt tone resample"
		default n
	config AUD_VAD_SUPPORT
		depends on AEC_VERSION_V3
		bool "Support Voice activity detection"
		default n

	config IMAGE_DEBUG_DUMP
		bool "Eable image dump sended to agent"
		default n
	config AUD_INTF_SUPPORT_MP3
		bool "Enable Aud intf support MP3 data type,only for decodeing"
		default n

	config AUD_INTF_SUPPORT_SPK_PLAY_FINISH_NOTIFY
		bool "Enable Aud intf support speaker data play finish notify"
		default n

	config JPEG_SW_DECODE_SUPPORT_BY_FRAME
		bool "Enable JPEG software decode by frame"
		default y

	config JPEG_SW_DECODE_SUPPORT_BY_CPU2
		depends on JPEG_SW_DECODE_SUPPORT_BY_FRAME
		bool "Enable JPEG software decode use cpu2"
		default y

	config CLEAR_AUDIO_DEC_BUFFER_AFTER_PROMPT_TONE_PLAY
		depends on AUD_INTF_SUPPORT_MULTIPLE_SPK_SOURCE_TYPE
		bool "Clear audio decoder buffer after prompt tone play"
		default n

	config LCD_PARTIAL_DISPLAY
		bool "mcu lcd partial display"
		default n
endmenu
```
